/*
 * Copyright 2019 Embedded Artists AB
 *
 * The code contained herein is licensed under the GNU General Public
 * License. You may obtain a copy of the GNU General Public License
 * Version 2 or later at the following locations:
 *
 * http://www.opensource.org/licenses/gpl-license.html
 * http://www.gnu.org/copyleft/gpl.html
 */

/dts-v1/;
 
#include "imx8mm-ea-ucom-kit_v2.dts"

/* WL_REG_ON is normally controlled by either usdhc1_pwrseq or
   reg_pcie0, but both the SDIO and PCIe interface are disabled
   when using the m.2 USB interface so WL_REG_ON has to be hogged
   here to force it HIGH. */
&gpio_buff {
	hog_WL_REG_ON {
		gpio-hog;
		gpios = <1 0>;
		output-high;
	};
};

&usdhc1_pwrseq {
	status = "disabled";
};

&usdhc1 {
	status = "disabled";
};
