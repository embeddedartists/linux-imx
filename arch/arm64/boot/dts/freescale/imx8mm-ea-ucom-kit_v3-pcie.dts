/*
 * Copyright 2019 Embedded Artists AB
 *
 * The code contained herein is licensed under the GNU General Public
 * License. You may obtain a copy of the GNU General Public License
 * Version 2 or later at the following locations:
 *
 * http://www.opensource.org/licenses/gpl-license.html
 * http://www.gnu.org/copyleft/gpl.html
 */

/dts-v1/;
 
#include "imx8mm-ea-ucom-kit_v3.dts"

&usdhc1_pwrseq {
	status = "disabled";
};

&pcie_phy {
	status = "okay";
};

&pcie0 {
	status = "okay";
};

&usdhc1 {
	status = "disabled";
};
