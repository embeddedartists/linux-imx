#include "imx8mm-ea-ucom-kit_v2.dts"

/* Add child node to serial port node to create serdev device */
&uart1 {
	bluetooth {
		compatible = "infineon,cyw55572-bt";
		shutdown-gpios = <&gpio_buff 0 GPIO_ACTIVE_HIGH>;
		max-speed = <3000000>;
		brcm,requires-autobaud-mode;
	};
};
