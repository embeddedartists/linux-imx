/*
 * Copyright 2025 Embedded Artists AB
 *
 * The code contained herein is licensed under the GNU General Public
 * License. You may obtain a copy of the GNU General Public License
 * Version 2 or later at the following locations:
 *
 * http://www.opensource.org/licenses/gpl-license.html
 * http://www.gnu.org/copyleft/gpl.html
 */

/* For PCIe on M.2 M-Key */

/dts-v1/;
 
#include "imx8mm-ea-som-kit.dts"


&usdhc1_pwrseq {
	status = "disabled";
};

&pcie_phy {
	status = "okay";
};

&pcie0 {
	status = "okay";
	reset-gpio = <&pcal6524_u5 15 GPIO_ACTIVE_LOW>;   /* M2M_PERST# */
};

&usdhc1 {
	status = "disabled";
};
