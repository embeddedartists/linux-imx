/*
 * Copyright 2025 Embedded Artists AB
 *
 * The code contained herein is licensed under the GNU General Public
 * License. You may obtain a copy of the GNU General Public License
 * Version 2 or later at the following locations:
 *
 * http://www.opensource.org/licenses/gpl-license.html
 * http://www.gnu.org/copyleft/gpl.html
 */

/* For using onboard DeepX module. PCIe on Carrier Board not available. */

/dts-v1/;
 
#include "imx8mm-ea-som-kit.dts"


&pcie_phy {
	status = "okay";
};

&pcie0 {
	reset-gpio = <&gpio3 8 GPIO_ACTIVE_LOW>;   /* Onboard DeepX */
	status = "okay";
};
