/*
 * Copyright (C) 2015 Freescale Semiconductor, Inc.
 *
 * This program is free software; you can redistribute it and/or modify
 * it under the terms of the GNU General Public License version 2 as
 * published by the Free Software Foundation.
 */

#include "imx6ulea-com-kit.dts"

&can2 {
	status = "disabled";
};


&uart2 {
	pinctrl-names = "default";
	pinctrl-0 = <&pinctrl_uart2>;
	status = "okay";

	fsl,uart-has-rtscts;
	#fsl,irda-mode;
	#fsl,dte-mode;
};

&pinctrl_uart2 {
	fsl,pins = <
		MX6UL_PAD_UART2_TX_DATA__UART2_DCE_TX	0x1f0b1
		MX6UL_PAD_UART2_RX_DATA__UART2_DCE_RX	0x1f0b1
		MX6UL_PAD_UART2_RTS_B__UART2_DCE_RTS 	0x1b0b1
		MX6UL_PAD_UART2_CTS_B__UART2_DCE_CTS 	0x1b0b1

		/* RF_ON */
		/* MX6UL_PAD_NAND_DQS__GPIO4_IO16 	0x1b0b1*/

		/* RF_CD */
		MX6UL_PAD_UART1_RTS_B__GPIO1_IO19 	0x1b0b1

		/* RF_DTR */
		MX6UL_PAD_UART1_CTS_B__GPIO1_IO18 	0x1b0b1

		/* RF_RST */
		MX6UL_PAD_CSI_DATA02__GPIO4_IO23 	0x1b0b1
	>;
};
