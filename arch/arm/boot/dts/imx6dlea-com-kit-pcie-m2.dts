/*
 * Copyright 2012 Freescale Semiconductor, Inc.
 * Copyright 2011 Linaro Ltd.
 *
 * The code contained herein is licensed under the GNU General Public
 * License. You may obtain a copy of the GNU General Public License
 * Version 2 or later at the following locations:
 *
 * http://www.opensource.org/licenses/gpl-license.html
 * http://www.gnu.org/copyleft/gpl.html
 */

#include "imx6dlea-com-kit-pcie.dts"


&gpio_buff {
	hog_PCIE_SLOT_MUX_CTRL {
		gpio-hog;
		gpios = <8 0>;
		output-low; /* High for J23 (Samtec PCIe), Low for J30 (M.2 PCIe) */
	};
};
