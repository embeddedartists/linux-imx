
/*
 * Copyright (C) 2014-2015 Freescale Semiconductor, Inc.
 *
 * This program is free software; you can redistribute it and/or modify
 * it under the terms of the GNU General Public License version 2 as
 * published by the Free Software Foundation.
 */

#include "imx6qea-com-kit.dts"



&i2c1 {
	egalax_ts_lvds {
		status = "okay";
	};

};

&mxcfb1 {
	status = "okay";
};


