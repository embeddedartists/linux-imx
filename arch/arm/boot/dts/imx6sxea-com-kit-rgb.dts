/*
 * Copyright (C) 2014-2015 Freescale Semiconductor, Inc.
 *
 * This program is free software; you can redistribute it and/or modify
 * it under the terms of the GNU General Public License version 2 as
 * published by the Free Software Foundation.
 */

#include "imx6sxea-com-kit.dts"



/*
 * Disable the LVDS interface to only have RGB enabled
 */
&lcdif2 {
	status = "disabled";
};


